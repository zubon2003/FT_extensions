// YLED slave (countdown) — matrix BMP frame panel.
//
// Drives a WS2812B matrix and displays one of seven PROGMEM frames produced
// by tools/bmp2header.py when the corresponding system event arrives over
// ESP-NOW:
//
//   R → ready / 5 4 3 2 1 → countdown / G → go / E → blank
//
// Architecture: at boot all seven PROGMEM frames are decoded into separate
// RAM-resident CRGB[] buffers. The ESP-NOW receive callback only flips a
// volatile pointer to the next frame to display; loop() picks it up and
// runs the memcpy + FastLED.show(). This keeps the Wi-Fi receive task free
// of LED bitbang work, so back-to-back countdown packets aren't dropped
// while a previous show() is still running.
//
// Pilot-pass packets (TYPE_PILOT) are deliberately ignored — fade rendering
// lives in ledslave_normal.

#include <FastLED.h>
#include <esp_now.h>
#include <WiFi.h>
#include <esp_wifi.h>

// --- Hardware -------------------------------------------------------------

#define DATA_PIN            10
#define BRIGHTNESS          64     // 0–255

// --- Network --------------------------------------------------------------

#define CHANNEL             11     // Must match ledmaster

// --- Protocol -------------------------------------------------------------

#define PACKET_SIZE          5
#define TYPE_PILOT        0x01
#define TYPE_SYSTEM       0x02

// --- Frame data (PROGMEM, generated by bmp2header.py) ---------------------

#include "images/ready.h"
#include "images/5.h"
#include "images/4.h"
#include "images/3.h"
#include "images/2.h"
#include "images/1.h"
#include "images/go.h"

// NUM_LEDS is derived from the frame byte length: PROGMEM array size / 3
// (R,G,B per pixel). Treating frame_ready as the reference keeps the
// firmware free of MATRIX_WIDTH/HEIGHT defines; the script is the single
// source of truth for matrix geometry.
#define NUM_LEDS (sizeof(frame_ready) / 3)

static_assert(sizeof(frame_5)  == sizeof(frame_ready), "frame_5 size differs from frame_ready");
static_assert(sizeof(frame_4)  == sizeof(frame_ready), "frame_4 size differs from frame_ready");
static_assert(sizeof(frame_3)  == sizeof(frame_ready), "frame_3 size differs from frame_ready");
static_assert(sizeof(frame_2)  == sizeof(frame_ready), "frame_2 size differs from frame_ready");
static_assert(sizeof(frame_1)  == sizeof(frame_ready), "frame_1 size differs from frame_ready");
static_assert(sizeof(frame_go) == sizeof(frame_ready), "frame_go size differs from frame_ready");

// --- RAM-resident frame buffers, populated once at boot -------------------
// 7 frames × NUM_LEDS × 3 bytes. For 49-LED matrix that's ~1 KB total —
// trivial on ESP32 (≥320 KB DRAM). Display path becomes a single memcpy
// instead of NUM_LEDS PROGMEM reads + RGB struct construction.

static CRGB leds[NUM_LEDS];
static CRGB buf_ready[NUM_LEDS];
static CRGB buf_5[NUM_LEDS];
static CRGB buf_4[NUM_LEDS];
static CRGB buf_3[NUM_LEDS];
static CRGB buf_2[NUM_LEDS];
static CRGB buf_1[NUM_LEDS];
static CRGB buf_go[NUM_LEDS];
static CRGB buf_blank[NUM_LEDS];  // all-black, prepared once for the E path

static void decodeFrame(CRGB* dst, const uint8_t* src) {
    for (int i = 0; i < (int)NUM_LEDS; i++) {
        dst[i].r = pgm_read_byte(&src[i * 3 + 0]);
        dst[i].g = pgm_read_byte(&src[i * 3 + 1]);
        dst[i].b = pgm_read_byte(&src[i * 3 + 2]);
    }
}

// --- Pending frame, written by ESP-NOW callback, consumed by loop() -------
// volatile so the compiler doesn't cache it; pointer-sized writes are
// naturally atomic on ESP32 so no further synchronisation is needed. If two
// packets land between loop() iterations the older one is simply replaced
// and only the latest one is rendered — that's the desired behaviour.

static volatile CRGB* pendingFrame = nullptr;

static void onSystem(char cmd) {
    switch (cmd) {
        case 'R': pendingFrame = buf_ready; break;
        case '5': pendingFrame = buf_5;     break;
        case '4': pendingFrame = buf_4;     break;
        case '3': pendingFrame = buf_3;     break;
        case '2': pendingFrame = buf_2;     break;
        case '1': pendingFrame = buf_1;     break;
        case 'G': pendingFrame = buf_go;    break;
        case 'E': pendingFrame = buf_blank; break;
        default:                            break;
    }
#if defined(YLED_DEBUG)
    Serial.printf("RX SYSTEM '%c'\n", cmd);
#endif
}

static void processPacket(const uint8_t* p) {
    if (p[0] == TYPE_SYSTEM) {
        onSystem((char)p[1]);
    }
    // TYPE_PILOT intentionally ignored — see ledslave_normal.
}

static void onReceiveData(const esp_now_recv_info_t* /*info*/, const uint8_t* data, int len) {
    if (len != PACKET_SIZE) return;
    const uint8_t crc = data[0] ^ data[1] ^ data[2] ^ data[3];
    if (crc != data[4]) return;
    processPacket(data);
    // NOTE: no FastLED.show() here. The bitbang would hold the Wi-Fi task
    // long enough to drop the very next ESP-NOW packet (e.g. "4" arriving
    // mid-render of "5"), causing the visible "5 → 3" skip the user reported.
}

// --- Setup / loop ---------------------------------------------------------

void setup() {
    FastLED.addLeds<WS2812B, DATA_PIN, GRB>(leds, NUM_LEDS);
    FastLED.setBrightness(BRIGHTNESS);

    // Pre-decode every PROGMEM frame into its own RAM buffer. After this
    // setup completes, the render path on packet receive is just a memcpy.
    decodeFrame(buf_ready, frame_ready);
    decodeFrame(buf_5,     frame_5);
    decodeFrame(buf_4,     frame_4);
    decodeFrame(buf_3,     frame_3);
    decodeFrame(buf_2,     frame_2);
    decodeFrame(buf_1,     frame_1);
    decodeFrame(buf_go,    frame_go);
    fill_solid(buf_blank, NUM_LEDS, CRGB::Black);

    // Initial visible state = blank (matches the historical 'E' behaviour).
    memcpy(leds, buf_blank, sizeof(leds));
    FastLED.show();

    Serial.begin(115200);
    delay(2000);
    Serial.println("YLED slave (countdown, deferred render) starting");

    WiFi.mode(WIFI_STA);
    esp_wifi_set_ps(WIFI_PS_NONE);
    WiFi.disconnect();
    delay(500);

    esp_wifi_set_channel(CHANNEL, WIFI_SECOND_CHAN_NONE);
    if (esp_now_init() != ESP_OK) {
        Serial.println("ESP-NOW init failed");
        return;
    }
    esp_now_register_recv_cb(onReceiveData);
    Serial.printf("Channel %d, %d LEDs (%s wiring per frame headers) — ready\n",
                  CHANNEL, (int)NUM_LEDS,
                  FRAME_READY_SERPENTINE ? "serpentine" : "row-major");
}

void loop() {
    // Snapshot the pending pointer once; if a new packet lands between the
    // read and the memcpy, the new pointer simply waits for the next loop
    // iteration (a few ms later). That's preferable to rendering a half-
    // copied frame.
    CRGB* frame = const_cast<CRGB*>(pendingFrame);
    if (frame) {
        pendingFrame = nullptr;
        memcpy(leds, frame, sizeof(leds));
        FastLED.show();
    }
}
